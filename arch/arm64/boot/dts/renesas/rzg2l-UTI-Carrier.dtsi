// SPDX-License-Identifier: (GPL-2.0-only OR BSD-2-Clause)
/*
 * Device Tree Source for the RZ/{G2L,V2L} SMARC EVK common parts
 *
 * Copyright (C) 2021 Renesas Electronics Corp.
 */

#include <dt-bindings/gpio/gpio.h>
#include <dt-bindings/pinctrl/rzg2l-pinctrl.h>

/* comment the #define statement to disable SCIF2 (SER0) on PMOD1 (CN7) */
//#define PMOD1_SER0	1

/ {
	aliases {
		serial1 = &scif2;
	};

};






